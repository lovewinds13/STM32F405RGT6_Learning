//-----------------------------------------------------------------------------------------------------------
//
//	模块名称 : BSP模块(For STM32F405RGT6)
//	文件名称 : bsp.c
//	版    本 : V1.0
//	说    明 : 这是硬件底层驱动程序的主文件。每个c文件可以 #include "bsp.h" 来包含所有的外设驱动模块。
//			   bsp = Borad surport packet 板级支持包
//	修改记录 :
//		版本号  日期         作者       说明
//		V1.0    2021-06-23  霁风AI   正式发布
//
//	Copyright (C), 2021-2030, 微信公众号 TECHTIMES
//
//------------------------------------------------------------------------------------------------------------


//------------------------------------------------------------------------------------------------------------
//	STM32F405RGT6开发板LED口线分配：
//		LED0     : PA1          (低电平点亮，高电平熄灭)
//		LED1     : PA2          (低电平点亮，高电平熄灭)
//------------------------------------------------------------------------------------------------------------

#ifndef __PRJ_STM32F40X_DRVBUTTON_C__
#define __PRJ_STM32F40X_DRVBUTTON_C__

#include "drvbutton.h"
#include "delay.h"

//--------------------------------------------------------------------------------------------------------------------------
//	函 数 名: button_gpio_init
//	功能说明: 按键GPIO初始化
//	形    参: 无
//	返 回 值: 无
//	日    期: 2021-06-23
//  备    注: 按键GPIO初始化
//	作    者: by 霁风AI
//-------------------------------------------------------------------------------------------------------------------------
void button_gpio_init(void)
{
	GPIO_InitTypeDef  gp_init;

	RCC_AHB1PeriphClockCmd(RCC_BUTTON_GPIO_CLK, ENABLE);	 //使能PA端口时钟

	gp_init.GPIO_Pin 	= BUTTON1_IO | BUTTON2_IO;				 //LED0-->PA.1 端口配置
	gp_init.GPIO_Mode 	= GPIO_Mode_IN;			//普通输出模式
//	gp_init.GPIO_OType 	= GPIO_OType_PP; 		 //推挽输出
	gp_init.GPIO_Speed 	= GPIO_Speed_100MHz;		 //IO口速度为100MHz
	gp_init.GPIO_PuPd 	= GPIO_PuPd_UP;			//上拉
	GPIO_Init(BUTTONS_PORT, &gp_init);					 		
}

//--------------------------------------------------------------------------------------------------------------------------
//	函 数 名: button_detect
//	功能说明: 按键键值检测
//	形    参: key_mode：是否支持按键连续触发
//	返 回 值: 0：无按键按下;其他：按键值
//	日    期: 2021-06-23
//  备    注: 
//	作    者: by 霁风AI
//-------------------------------------------------------------------------------------------------------------------------
uint8_t button_detect(uint8_t key_mode)
{
	 uint8_t key_up = 1;	//按键松开标识
	
	if (key_mode)	//支持连续按下
		key_up = 1;
	if (key_up && (KEY1_VAL==0 || KEY2_VAL==0))
	{
		delay_ms(10);
		key_up = 0;
		if (KEY1_VAL == 0)
			return KEY1_DOWN;
		else if (KEY2_VAL == 0)
			return KEY2_DOWN;
		else if (KEY1_VAL==1 && KEY2_VAL==1)
			key_up = 1;
	}
	
	return 0;
}

#endif	//__PRJ_STM32F40X_DRVBUTTON_C__

//***************************** 微信公众号 TECHTIMES (END OF FILE) *********************************/
